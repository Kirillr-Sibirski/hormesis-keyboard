## boards/shields/hormesis/kconfig.defconfig
```kconfig
if SHIELD_HORMESIS_LEFT

# Name must be less than 16 characters long!
config ZMK_KEYBOARD_NAME
    default "hormesis"

config ZMK_SPLIT_ROLE_CENTRAL
    default y

endif

if SHIELD_HORMESIS_LEFT || SHIELD_HORMESIS_RIGHT

config ZMK_SPLIT
    default y

endif
```

## boards/shields/hormesis/kconfig.shield
```kconfig
# No whitespace after the comma or in your part name!
config SHIELD_HORMESIS_LEFT
    def_bool $(shields_list_contains,hormesis_left)

# No whitespace after the comma or in your part name!
config SHIELD_HORMESIS_RIGHT
    def_bool $(shields_list_contains,hormesis_right)
```
